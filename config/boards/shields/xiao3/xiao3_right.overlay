#include "xiao3.dtsi"

&default_transform {
    col-offset = <6>;
};

&kscan0 {
    col-gpios               // Col1-7 0.09 1.14 1.15 1.10 1.00 0.16 0.29**
        = <&gpio0 9 GPIO_ACTIVE_HIGH> 
        , <&gpio1 14 GPIO_ACTIVE_HIGH>
        , <&gpio1 15 GPIO_ACTIVE_HIGH>
        , <&gpio1 10 GPIO_ACTIVE_HIGH> 
        , <&gpio1 0 GPIO_ACTIVE_HIGH> 
        , <&gpio0 16 GPIO_ACTIVE_HIGH> 
//        , <&gpio0 29 GPIO_ACTIVE_HIGH> 
        ;
};
